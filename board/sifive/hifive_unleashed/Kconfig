## board/sifive/hifive_unleashed/Kconfig
```kconfig
if TARGET_SIFIVE_HIFIVE_UNLEASHED

config SYS_BOARD
	default "hifive_unleashed"

config SYS_VENDOR
	default "sifive"

config SYS_SOC
	default "fu540-c000"

config SYS_CPU
	default "u54-mc"

config SYS_CONFIG_NAME
	default "hifive_unleashed"

config SYS_TEXT_BASE
	default 0x80000000 if !RISCV_SMODE
	default 0x80200000 if RISCV_SMODE

config BOARD_SPECIFIC_OPTIONS # dummy
	def_bool y
	select U54_MC_RISCV
	imply CMD_DHCP
	imply CMD_EXT2
	imply CMD_EXT4
	imply CMD_FAT
	imply CMD_FS_GENERIC
	imply CMD_NET
	imply CMD_PING
	imply CLK_SIFIVE
	imply CLK_SIFIVE_FU540_PRCI
	imply DOS_PARTITION
	imply EFI_PARTITION
	imply IP_DYN
	imply ISO_PARTITION
	imply MACB
	imply MII
	imply NET_RANDOM_ETHADDR
	imply PHY_LIB
	imply PHY_MSCC
	imply SIFIVE_SERIAL
	imply SPI
	imply SPI_SIFIVE
	imply MMC
	imply MMC_SPI
	imply MMC_BROKEN_CD
	imply CMD_MMC
	imply SMP

endif
```

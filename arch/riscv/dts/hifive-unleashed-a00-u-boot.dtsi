// SPDX-License-Identifier: GPL-2.0+
/*
 * Copyright (C) 2019 Jagan Teki <jagan@amarulasolutions.com>
 */

/ {
	aliases {
		spi0 = &qspi0;
		spi2 = &qspi2;
	};
};

&qspi0 {
	flash@0 {
		spi-tx-bus-width = <1>;
		spi-rx-bus-width = <1>;
	};
};

